/* Copyright (c) 2020, The Linux Foundation. All rights reserved.
*  Copyright (c) 2015, Lenovo.
*  Copyright (c) 2020, the_shahnawaz_sheikh (sheikhshahnawaz41299).
*
* This program is free software; you can redistribute it and/or modify
* it under the terms of the GNU General Public License version 2 and
* only version 2 as published by the Free Software Foundation.
*
* This program is distributed in the hope that it will be useful,
* but WITHOUT ANY WARRANTY; without even the implied warranty of
* MERCHANTABILITY or FITNESS FOR A PARTICULAR PURPOSE.  See the
* GNU General Public License for more details.
*/

/dts-v1/;

#include "msm8939.dtsi"
#include "msm8939-qrd-skuk.dtsi"
#include "pb1770m/msm8939-qrd-pb1770m.dtsi"

/ {
	model = "Qualcomm Technologies, Inc. MSM8939 QRD SKUK";
	compatible = "qcom,msm8939-qrd-skuk", "qcom,msm8939-qrd", "qcom,msm8939", "qcom,qrd";
	qcom,board-id = <0x1000b 5>, <0x2000b 5>;
};

&pm8916_chg {
	status = "ok";
	qcom,use-external-charger;
};

&pm8916_bms {
	status = "ok";
	/delete-property/ qcom,battery-data;
	qcom,battery-data = <&qrd_batterydata>;
};


&usb_otg {
       qcom,hsusb-otg-phy-init-seq =
			<0x74 0x80 0x6D 0x81 0x3F 0x82 0x33 0x83 0xffffffff>;
       qcom,hsusb-otg-mode = <3>;
       qcom,usbid-gpio = <&msm_gpio 110 0>;
       pinctrl-names = "default";
       pinctrl-0 = <&usbid_default>;
       vbus_otg-supply = <&smb358_otg_supply>;
};
